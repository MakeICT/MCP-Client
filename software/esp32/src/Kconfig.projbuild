## software/esp32/src/Kconfig.projbuild
```kconfig
menu "MCP Configuration"

	config CLIENT_ID
	    int "Client ID"
	    default "99"
	    help
	        Unique id for client

	config USE_WIFI
		bool "Use WiFi"
		default False
		help 
			If checked Wifi will be used, otherwise ethernet will be used.
	
	config WIFI_SSID
	    string "WiFi SSID" if USE_WIFI
		default "myssid"
		help
			SSID (network name) for the example to connect to.
	
	config WIFI_PASSWORD
	    string "WiFi Password" if USE_WIFI
		default "mypassword"
		help
			WiFi password (WPA or WPA2) for the example to use.
	
			Can be left blank if the network has no security set.

	config STATIC_IP
		bool "Set static IP"
		default False
		help
			Disable DHCP and set client IP, gateway, and netmask statically

	config CLIENT_IP
		string "Client IP" if STATIC_IP
		default "192.168.1.100"
		help
			Static client IP address	
			
	config GATEWAY_IP
		string "Gateway IP" if STATIC_IP
		default "192.168.1.1"
		help
			Default gateway IP address	
			
	config NETMASK
		string "Netmask" if STATIC_IP
		default "255.255.255.0"
		help
			Netmask for static network
	
	config SERVER
	    string "Server Address"
		default "securitytest.makeict.org"
		help
			Address of Master Control Program instance to connect to.
	
	config PORT
	    string "Server Port"
		default "4443"
		help
			Port of Master Control Program instance to connect to.
	
	config USERNAME
	    string "MCP Username"
		default "username"
		help
			Username (email) of MCP user.
	
	config PASSWORD
	    string "MCP Password"
		default "password"
		help
			Password of MCP user.

	config DOOR_DELAY
	    int "Door Delay MS"
		default 500
		help
			Delay MS between validation and opening door

	config DOOR_OPEN
	    int "Door Open MS"
		default 5000
		help
			Number of MS to keep door strike energized.
	
	config CURRENT_TIMEOUT
	    int "Current Sensor Timeout"
	    default 5
	    help
	        Number of seconds before client deactivates due to current below threshold.


endmenu
```
